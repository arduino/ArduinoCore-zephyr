## dts/bindings/emul/arduino,emul-atecc608.yaml
```yaml
# Copyright (c) Arduino s.r.l. and/or its affiliated companies
# SPDX-License-Identifier: Apache-2.0

title: Emulated Microchip ATECC608 secure element

description: |
    Emulated ATECC608 secure element (native_sim loader), with only what the
    secure element libraries need to start and to read data: the wake-up,
    idle and sleep sequences, and the Info (revision), Read (configuration
    zone: serial number and lock bytes, locked) and Random (fixed bytes)
    commands. Other commands fail with an execution error.

compatible: "arduino,emul-atecc608"

include: i2c-device.yaml
```

## dts/bindings/emul/arduino,emul-i2c-regs.yaml
```yaml
# Copyright (c) Arduino s.r.l. and/or its affiliated companies
# SPDX-License-Identifier: Apache-2.0

title: Emulated I2C device with a register file

description: |
    Emulated I2C device (native_sim loader) made of 256 byte-wide registers,
    for chips that are read and written through a register pointer: a write
    sets the pointer with its first byte and stores the following bytes, a
    read returns the registers from the pointer; both increment the pointer
    after each byte. The registers start at 0, then take the values of the
    'regs' property.

    Example, an LPS22HB (WHO_AM_I = 0xb1, one-shot bit of CTRL2 cleared
    as soon as it is set):

        lps22hb@5c {
            compatible = "arduino,emul-i2c-regs";
            reg = <0x5c>;
            regs = [0f b1];
            self-clearing-bits = [11 01];
        };

compatible: "arduino,emul-i2c-regs"

include: i2c-device.yaml

properties:
  regs:
    type: uint8-array
    description: |
      Initial register values, as (register, value) pairs.

  self-clearing-bits:
    type: uint8-array
    description: |
      Bits cleared right after a write to their register, as (register,
      mask) pairs: e.g. the trigger bit of a measurement that completes at
      once.
```

## dts/bindings/emul/arduino,emul-m95m01.yaml
```yaml
# Copyright (c) Arduino s.r.l. and/or its affiliated companies
# SPDX-License-Identifier: Apache-2.0

title: Emulated ST M95M01 SPI EEPROM

description: |
    Emulated ST M95M01 SPI EEPROM (native_sim loader): 128 KiB in pages of
    256 bytes, erased (0xff) at start, with the RDSR, WREN, WRDI, WRSR, READ
    and WRITE commands; writes complete at once.

    The chip select is a GPIO the sketch drives (e.g. with digitalWrite), not
    the one of the SPI controller: the emulator follows the level of that
    GPIO, and a command starts at each falling edge.

compatible: "arduino,emul-m95m01"

include: spi-device.yaml

properties:
  cs-monitor-gpios:
    type: phandle-array
    required: true
    description: |
      GPIO (of an emulated GPIO controller) used as the chip select.
```

## loader/Kconfig
```kconfig
#
# Copyright (c) Arduino s.r.l. and/or its affiliated companies
#
# SPDX-License-Identifier: Apache-2.0
#

config PINCTRL
	select PINCTRL_NON_STATIC

source "Kconfig.zephyr"

config LLEXT_HEAP_REGION
	string "LLEXT heap memory region"
	depends on CODE_DATA_RELOCATION
	help
	  Specify the memory region for LLEXT heap.

config MAIN_STACK_REGION
	string "Main stack memory region"
	depends on CODE_DATA_RELOCATION
	help
	  Specify the memory region for main stack.

config ARDUINO_NATIVE_SKETCH_BASE
	hex "Sketch load address on native targets"
	depends on ARCH_POSIX
	default 0x60000000
	help
	  Fixed host address where the sketch file given with --sketch is
	  mapped. Static sketches are linked for this address.
	  Linux places the heap (brk) of 64-bit processes at a random offset
	  of up to 1 GiB after the executable: the default is above that, to
	  never collide with it, and below 2 GiB, for the default code model
	  of the static sketches.

config ARDUINO_NATIVE_SKETCH_MAX_SIZE
	hex "Maximum sketch size on native targets"
	depends on ARCH_POSIX
	default 0x400000

rsource "ota/Kconfig"
```

## loader/Kconfig.arduino_iotcloud
```kconfig
#
# Copyright (c) Arduino s.r.l. and/or its affiliated companies
#
# SPDX-License-Identifier: Apache-2.0
#

config ARDUINO_IOTCLOUD
	bool "Arduino IoT Cloud support"
	depends on NETWORKING
	depends on NET_TCP
	depends on NET_SOCKETS
	imply SETTINGS				if !BOARD_ARDUINO_NANO_CONNECT
	imply NVS				if !BOARD_ARDUINO_NANO_CONNECT
	imply NVS_DATA_CRC			if !BOARD_ARDUINO_NANO_CONNECT
	imply NVS_INIT_BAD_MEMORY_REGION	if !BOARD_ARDUINO_NANO_CONNECT
	select CRC_DRIVER
	select CRC_DRIVER_HAS_CRC32_IEEE
	help
	  Enable the Arduino IoT Cloud support and bring in zephyr packages required to run it

config ARDUINO_IOTCLOUD_OTA
	bool "Arduino IoT Cloud OTA support"
	depends on ARDUINO_IOTCLOUD && OTA
	default y
```

## loader/Kconfig.sysbuild
```kconfig
#
# Copyright (c) Arduino s.r.l. and/or its affiliated companies
#
# SPDX-License-Identifier: Apache-2.0
#
#
# loader/Kconfig.sysbuild

source "share/sysbuild/Kconfig"

config ENFORCE_SECURE_WATCHDOG
    bool "Enforce hardware watchdog at boot"
    depends on BOOTLOADER_MCUBOOT
    default n

config SECURE_WATCHDOG_TIMEOUT_MS
    int "Watchdog timeout in milliseconds"
    default 20000
    help
      The actual timeout may be clamped by the hardware watchdog's maximum
      supported value (e.g. 16384 ms on PIC32), so check the SoC's watchdog
      driver limits before raising this.
```

## loader/mcuboot_hooks/Kconfig
```kconfig
# Copyright (c) Arduino s.r.l. and/or its affiliated companies
# SPDX-License-Identifier: Apache-2.0

config ARDUINO_MCUBOOT_DFU_BOOT_MODE
	bool "USB DFU on a retention boot mode request"
	depends on MCUBOOT && BOOT_USB_DFU && RETENTION_BOOT_MODE
	select BOOT_GO_HOOKS
	select MCUBOOT_ACTION_HOOKS
	select REBOOT
	help
	  When the bootloader boot mode is set (1200-bps touch, double tap),
	  wait in USB DFU without a timeout; MCUboot keeps feeding the
	  watchdog. Without a bootable image, reboot into the same mode.

config ARDUINO_MCUBOOT_DOUBLE_TAP
	bool "Double tap of the reset button into USB DFU"
	depends on ARDUINO_MCUBOOT_DFU_BOOT_MODE
	depends on $(dt_nodelabel_enabled,retained_ram)
	help
	  A second reset-button press within 500 ms sets the bootloader boot
	  mode. The cookie lives at offset 0 of the retained_ram node; set
	  CONFIG_RETAINED_MEM_INIT_PRIORITY=0 so it is armed before clock
	  bring-up.

config ARDUINO_MCUBOOT_DFU_FADE_LED
	bool "Fade the mcuboot-fade-led0 LED while waiting in USB DFU"
	depends on ARDUINO_MCUBOOT_DFU_BOOT_MODE
	depends on $(dt_alias_enabled,mcuboot-fade-led0)
	select PWM
```
