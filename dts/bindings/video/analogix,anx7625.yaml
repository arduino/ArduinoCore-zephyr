## dts/bindings/video/analogix,anx7625.yaml
```yaml
# Copyright (c) Arduino SRL
# SPDX-License-Identifier: Apache-2.0

title: Analogix ANX7625 MIPI-DSI to DisplayPort bridge

description: |
    Analogix ANX7625 MIPI-DSI to DisplayPort converter bridge.

compatible: "analogix,anx7625"

include: [mipi-dsi-device.yaml]

properties:
  i2c-bus:
    type: phandle
    required: true
    description: I2C controller used for the video bridge

  video-on-gpios:
    type: phandle-array
    description: GPIO for powering on the video bridge

  video-rst-gpios:
    type: phandle-array
    description: GPIO for resetting the video bridge

  otg-on-gpios:
    type: phandle-array
    description: GPIO for OTG control
```

## loader/boards/arduino_giga_r1_m7.conf
```kconfig
CONFIG_USB_DEVICE_STACK=y
CONFIG_USB_DEVICE_PRODUCT="Arduino GIGA R1"
CONFIG_USB_DEVICE_MANUFACTURER="Arduino"
CONFIG_USB_DEVICE_VID=0x2341
CONFIG_USB_DEVICE_PID=0x0066

CONFIG_USB_CDC_ACM=y
CONFIG_USB_CDC_ACM_RINGBUF_SIZE=512
CONFIG_UART_LINE_CTRL=y
CONFIG_CDC_ACM_DTE_RATE_CALLBACK_SUPPORT=y

CONFIG_LLEXT_STORAGE_WRITABLE=n
CONFIG_HEAP_MEM_POOL_SIZE=2048
CONFIG_SHELL_STACK_SIZE=32768
CONFIG_MAIN_STACK_SIZE=32768
CONFIG_LLEXT_HEAP_SIZE=128

CONFIG_FPU=y

CONFIG_ADC=y
CONFIG_PWM=y

CONFIG_DMA=y
CONFIG_MEMC=y

#CONFIG_VIDEO=y
CONFIG_VIDEO_STM32_DCMI=y
CONFIG_VIDEO_BUFFER_POOL_NUM_MAX=1
CONFIG_VIDEO_BUFFER_POOL_SZ_MAX=160000

CONFIG_ENTROPY_GENERATOR=y
CONFIG_TEST_RANDOM_GENERATOR=y

CONFIG_CPP=y
CONFIG_STD_CPP17=y
```

## loader/dts/bindings/cannectivity.yaml
```yaml
# Copyright (c) 2024 Henrik Brix Andersen <henrik@brixandersen.dk>
# SPDX-License-Identifier: Apache-2.0

description: |
  CANnectivity hardware configuration

  Example:
    cannectivity: cannectivity {
      compatible = "cannectivity";
      timestamp-counter = <&counter0>;

      channel {
        compatible = "cannectivity-channel";
        can-controller = <&can0>;
        termination-gpios = <&gpio0 6 GPIO_ACTIVE_HIGH>;
        state-led = <&ch0_state_led>;
        error-led = <&ch0_error_led>;
        activity-leds = <&ch0_activity_led>;
      };

      channel {
        compatible = "cannectivity-channel";
        can-controller = <&can1>;
        termination-gpios = <&gpio0 9 GPIO_ACTIVE_HIGH>;
        state-led = <&ch1_state_led>;
        error-led = <&ch1_error_led>;
        activity-leds = <&ch1_activity_led>;
      };
    };

compatible: "cannectivity"

include: base.yaml

properties:
  timestamp-counter:
    type: phandle
    description: |
      Phandle to 32-bit counter node running @ 1MHz. This counter is used for hardware timestamping
      of received and transmitted CAN frames.

child-binding:
  description: |
    CANnectivity CAN channel configuration. Channels are indexed in the order they appear in the
    final devicetree.

  compatible: "cannectivity-channel"

  properties:
    can-controller:
      type: phandle
      required: true
      description: |
        Phandle to the CAN controller node for this CAN channel.

    termination-gpios:
      type: phandle-array
      description: |
        GPIO to use to enable/disable the CAN channel termination resistor. This GPIO is driven
        active when the CAN termination is enabled and inactive when the CAN termination is
        disabled.

    state-led:
      type: phandle
      description: |
        Phandle for the CAN channel state LED.

    error-led:
      type: phandle
      description: |
        Phandle for the CAN channel error LED.

    activity-leds:
      type: phandles
      description: |
        Phandle(s) for the CAN channel activity LED(s).

        If two LED phandles are specified, the LED phandle at index 0 will be used for indicating RX
        activity, and the LED phandle at index 1 will be used for indicating TX activity.
```
