## Kconfig
```kconfig
#
# Copyright (c) 2022 Dhruva Gole
#
# SPDX-License-Identifier: Apache-2.0
#

config ARDUINO_API
	bool "ARDUINO_API"
	imply CPP
	imply GPIO
	imply I2C
	imply NEWLIB_LIBC_FLOAT_PRINTF
	imply CBPRINTF_FP_SUPPORT
	imply RING_BUFFER
	imply PINCTRL_KEEP_SLEEP_STATE
	select UART_INTERRUPT_DRIVEN
	default n

if ARDUINO_API

config QEMU_ICOUNT
	bool "QEMU icount mode"
	default n
	depends on QEMU_TARGET

config ARDUINO_API_SERIAL_BUFFER_SIZE
	int "Buffer size for Arduino Serial API"
	default 64

config ARDUINO_ENTRY
	bool "Provide arduino setup and loop entry points"
	default y

config ARDUINO_MAX_TONES
	int "Maximum number of tones that can be played simultaneously with tone()"
	default -1
	help
	  Specify the maximum number of tones that can be played simultaneously with tone().
	  If set to -1 (or any other negative value), the maximum number will be
	  determined from the system's digital pin configuration.

endif

if USB_DEVICE_STACK_NEXT

config USB_DEVICE_PRODUCT
	string "USB Device Product"
	default "Arduino Generic board"

config USB_DEVICE_MANUFACTURER
	string "USB Device Manufacturer"
	default "Arduino"

config USB_DEVICE_VID
	hex "USB Device Vendor ID"
	default 0x2341

config USB_DEVICE_PID
	hex "USB Device Product ID"
	default 0x0001

endif
```

## dts/bindings/ethernet/arduino,portenta-c33-ethernet.yaml
```yaml
# Copyright (c) Arduino s.r.l. and/or its affiliated companies
# SPDX-License-Identifier: Apache-2.0

description: Arduino Portenta C33 Ethernet

compatible: "arduino,portenta-c33-ethernet"

include: renesas,ra-ethernet.yaml

properties:
  phy-handle:
    dependency-mode: child-ignore
```

## loader/Kconfig
```kconfig
#
# Copyright (c) Arduino s.r.l. and/or its affiliated companies
#
# SPDX-License-Identifier: Apache-2.0
#

config PINCTRL
	select PINCTRL_NON_STATIC


config LLEXT_HEAP_REGION
	string "LLEXT heap memory region"
	depends on CODE_DATA_RELOCATION
	help
	  Specify the memory region for LLEXT heap.

config MAIN_STACK_REGION
	string "Main stack memory region"
	depends on CODE_DATA_RELOCATION
	help
	  Specify the memory region for main stack.

menu "Flash Padding Options"

choice FLASH_PADDING_STRATEGY
    prompt "Flash padding strategy"
    optional
    depends on !LINKER_LAST_SECTION_ID
	 depends on !MCUBOOT
    help
      Select how the firmware image is padded. Requires CONFIG_LINKER_LAST_SECTION_ID=n.

config FLASH_ALIGN_BASED_ON_DT_ERASE_DIM
    bool "Align based on Devicetree erase block size"

config CUSTOM_FLASH_ALIGN_ACTIVE
    bool "Align to a custom dimension"

endchoice

config CUSTOM_FLASH_ALIGN
    int "Custom flash alignment boundary"
    depends on CUSTOM_FLASH_ALIGN_ACTIVE
    default 1024
    help
      The dimension to align the padding to, disregarding the Devicetree block size.

endmenu

config LOADER_SKETCH_IN_MCUBOOT_IMAGE
	bool "Sketch is appended to the loader in the MCUboot image"
	depends on BOOTLOADER_MCUBOOT
	help
	  Load the sketch from slot0 at the offset zephyr-sketch-tool --squash
	  stores after the MCUboot header, instead of from a user_sketch
	  partition.

config APP_WATCHDOG_ENFORCED
    bool "Hardware watchdog enforced by Sysbuild (MCU Boot required)"
    default n
    help
      This is automatically set to 'y' by Sysbuild if the secure 
      watchdog parameters are injected into MCUBoot.

config APP_WATCHDOG_TIMEOUT_MS
    int "Watchdog timeout injected by Sysbuild"
    default 20000

source "Kconfig.zephyr"
rsource "ota/Kconfig"
```

## loader/Kconfig.arduino_iotcloud
```kconfig
#
# Copyright (c) Arduino s.r.l. and/or its affiliated companies
#
# SPDX-License-Identifier: Apache-2.0
#

config ARDUINO_IOTCLOUD
	bool "Arduino IoT Cloud support"
	default y if BOARD_ARDUINO_NICLA_VISION
	default y if BOARD_ARDUINO_PORTENTA_H7
	default y if BOARD_ARDUINO_OPTA
	default y if BOARD_ARDUINO_GIGA
	default y if BOARD_ARDUINO_PORTENTA_C33
	default y if BOARD_ARDUINO_NANO_CONNECT
	depends on NETWORKING
	depends on NET_TCP
	depends on NET_SOCKETS
	help
	  Enable the Arduino IoT Cloud support and bring in zephyr packages required to run it

if ARDUINO_IOTCLOUD

config ARDUINO_IOTCLOUD_OTA
	bool "Arduino IoT Cloud OTA support"
	default y if BOARD_ARDUINO_NICLA_VISION
	default y if BOARD_ARDUINO_PORTENTA_H7
	default y if BOARD_ARDUINO_OPTA
	default y if BOARD_ARDUINO_GIGA
	select OTA

endif # ARDUINO_IOTCLOUD
```

## loader/Kconfig.sysbuild
```kconfig
# loader/Kconfig.sysbuild

source "share/sysbuild/Kconfig"

config ENFORCE_SECURE_WATCHDOG
    bool "Enforce hardware watchdog at boot"
    default y

config SECURE_WATCHDOG_TIMEOUT_MS
    int "Watchdog timeout in milliseconds"
    default 20000
```

## loader/boards/arduino_mezza.conf
```kconfig
# used for blinking
CONFIG_PWM=y

#CONFIG_BOOTLOADER_MCUBOOT=y

CONFIG_USBD_DFU=y
CONFIG_FLASH=y
CONFIG_FLASH_MAP=y
CONFIG_STREAM_FLASH=y
CONFIG_IMG_MANAGER=y
CONFIG_IMG_ERASE_PROGRESSIVELY=y
```

## loader/hwinfo/Kconfig
```kconfig
#
# Copyright (c) Arduino s.r.l. and/or its affiliated companies
#
# SPDX-License-Identifier: Apache-2.0
#

config HWINFO_ARDUINO
	bool "Arduino hw info"
	depends on HWINFO
	select HWINFO_HAS_DRIVER
	default y if BOARD_ARDUINO_PORTENTA_C33
	default y if BOARD_ARDUINO_NANO_CONNECT
	default y if SOC_SERIES_STM32H7X
	depends on !HWINFO_RENESAS_RA && !HWINFO_STM32 && !HWINFO_RPI_PICO
	help
	  Enable Arduino hwinfo driver
```

## loader/ota/Kconfig
```kconfig
#
# Copyright (c) Arduino s.r.l. and/or its affiliated companies
#
# SPDX-License-Identifier: Apache-2.0
#

menuconfig OTA
	bool "Enable lookup for sketch update at boot"
	depends on FILE_SYSTEM
	select REBOOT
	select RTC if SOC_SERIES_STM32H7X
	default n
	help
	  Enable checking for an update inside of the filesystem. If a file inside of
	  OTA_SKETCH_UPDATE_PATH is found during the boot, the OTA procedure is started and the
	  current sketch binary is replaced

if OTA

config OTA_SKETCH_UPDATE_PATH
	string "The path it is looked for ota"
	default "/ota:/UPDATE_SKETCH.BIN"
	help
	  the path that is checked for a sketch new binary

config OTA_SKETCH_TEMP_PATH_POSTFIX
	string "temporary file name postfix for sketch ota not ready"
	default ".TEMP"
	help
	  String that is appended to sketch ota filename when it is still not ready to be loaded,
	  a rename operation is required to make the ota file enabled for next reboot

config OTA_TRANSCRIPTION_CHUNK_SIZE
	int "The size of the stack allocated chunk in bytes for transcription"
	default 1024
	help
	  The size of the stack allocated chunk in bytes for ota file transcription

module = OTA
module-str = OTA
module-help = Sets log level for OTA
source "subsys/logging/Kconfig.template.log_config"

endif
```
