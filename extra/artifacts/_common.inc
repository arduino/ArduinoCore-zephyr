# Copyright (c) Arduino s.r.l. and/or its affiliated companies
# SPDX-License-Identifier: Apache-2.0

# This file contains all the *static* files and directories that will be added
# to any core package archive.
#
# NOTE: board-specific entries in the 'firmwares/' and 'variants/' directories
#       are automatically added by package_core.sh depending on the information
#       in 'boards.txt', so they should not be included here.

# boards.txt and platform.txt are added by package_core.sh
programmers.txt
LICENSE
README.md
debugger/
doc/
cores/
libraries/
variants/_ldscripts/
variants/common/
